## package/cerebras/Config.in
```kconfig
source "package/cerebras/conman/Config.in"
source "package/cerebras/crash/Config.in"
```

## package/cerebras/conman/Config.in
```kconfig
config BR2_PACKAGE_CONMAN
        bool "conman"
        help

          Console manager for serial devices

          https://github.com/dun/conman.git
```

## package/cerebras/crash/Config.in
```kconfig
config BR2_PACKAGE_CRASH
        bool "crash"
        help

          Crash is a tool for debugging running linux kernels or kernel crash dumps

          https://github.com/crash-utility
```

## package/cpustat/Config.in
```kconfig
config BR2_PACKAGE_CPUSTAT

	bool "cpustat"

	help
	    cpustat periodically dumps out the current CPU utilisation
	    statistics of running processes. cpustat has been optimised
	    to have a minimal CPU overhead and typically uses about 35%
	    of the CPU compared to top. cpustat also includes some simple
	    statistical analysis options that can help characterise the
	    way CPUs are being loaded.

	    https://github.com/ColinIanKing/cpustat
```

## package/python-atomicwrites/Config.in
```kconfig
config BR2_PACKAGE_PYTHON_ATOMICWRITES
	bool "python-atomicwrites"
	help
        atomic file writes
```

## package/python-cycler/Config.in
```kconfig
config BR2_PACKAGE_PYTHON_CYCLER
	bool "python-cycler"
	select BR2_PACKAGE_PYTHON_SIX
	help
	  Composable style cycles
```

## package/python-kiwisolver/Config.in
```kconfig
config BR2_PACKAGE_PYTHON_KIWISOLVER
	bool "python-kiwisolver"
	select BR2_PACKAGE_PYTHON_SETUPTOOLS
	help
	   A fast implementation of the Cassowary constraint solver
```

## package/python-matplotlib/Config.in
```kconfig
config BR2_PACKAGE_PYTHON_MATPLOTLIB
	bool "python-matplotlib"
    select BR2_PACKAGE_FREETYPE
	select BR2_PACKAGE_LIBPNG
	select BR2_PACKAGE_PYTHON_CYCLER
	select BR2_PACKAGE_PYTHON_DATEUTIL
	select BR2_PACKAGE_PYTHON_KIWISOLVER
	select BR2_PACKAGE_PYTHON_NUMPY
	select BR2_PACKAGE_PYTHON_PYPARSING
	select BR2_PACKAGE_PYTHON_SETUPTOOLS
	help
	   Python plotting package
```

## package/python-pandas/Config.in
```kconfig
config BR2_PACKAGE_PYTHON_PANDAS
	bool "python-pandas"
	select BR2_PACKAGE_PYTHON_DATEUTIL
	select BR2_PACKAGE_PYTHON_NUMPY
	select BR2_PACKAGE_PYTHON_PYTZ
	help
	   Powerful data structures for data analysis, time series, and statistics
```

## package/python-pluggy/Config.in
```kconfig
config BR2_PACKAGE_PYTHON_PLUGGY
	bool "python-pluggy"
	select BR2_PACKAGE_PYTHON_SETUPTOOLS_SCM
	help
	  pluggy provides plugin and hook calling mechanisms
```

## package/python-pytest/Config.in
```kconfig
config BR2_PACKAGE_PYTHON_PYTEST
	bool "python-pytest"
	select BR2_PACKAGE_PYTHON_ATTRS
	select BR2_PACKAGE_PYTHON_ATOMICWRITES
	select BR2_PACKAGE_PYTHON_MORE_ITERTOOLS
	select BR2_PACKAGE_PYTHON_PLUGGY
	select BR2_PACKAGE_PYTHON_PY
	select BR2_PACKAGE_PYTHON_SETUPTOOLS
	select BR2_PACKAGE_PYTHON_SIX
	help
	  simple powerful testing with Python
```

## package/python-seaborn/Config.in
```kconfig
config BR2_PACKAGE_PYTHON_SEABORN
	bool "python-seaborn"
	select BR2_PACKAGE_PYTHON_NUMPY
	select BR2_PACKAGE_PYTHON_PANDAS
	select BR2_PACKAGE_PYTHON_SCIPY
	select BR2_PACKAGE_PYTHON_MATPLOTLIB
	help
	   Statistical data visualization
```
